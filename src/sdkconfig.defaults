## src/sdkconfig.defaults
```kconfig
CONFIG_IDF_TARGET="esp32s3"
CONFIG_ESP_DEFAULT_CPU_FREQ_MHZ_240=y
CONFIG_ESP_DEFAULT_CPU_FREQ_MHZ=240
CONFIG_FREERTOS_HZ=1000
CONFIG_COMPILER_OPTIMIZATION_PERF=y
CONFIG_ELF_LOADER=y
CONFIG_ELF_LOADER_LOAD_PSRAM=y
CONFIG_ELF_DYNAMIC_LOAD_SHARED_OBJECT=y
CONFIG_ESPTOOLPY_FLASHSIZE_16MB=y
```
